#define PROBEREQUESTS     true     // Receives data from remote ESP8266 devices on network
#define MQTT              true     // Communicate with MQTT clients
#define WEBSOCKETS        true     // Communicate with Websockets clients
#define ASYNCWEBSERVER    true     // Publishes web interface
#define FIRSTTIME         true     // Warning - This must be false.Make it true if creating new file for first time.

#include <WiFi.h>
#include <Arduino.h>
#include "LITTLEFS.h"
#include "time.h"   // Arduino built in
String Timestamp, Date, Day, Time, Hour;
//String dateReceived, dayReceived, timeReceived, hourReceived, rooms, V, S, T, H, P, L;
#define FORMAT_LITTLEFS_IF_FAILED true
  
const char* ssid = "";    // Your WiFi SSID
const char* password = ""; // Your WiFi Password
const char* apSSID = "ESP";        // SSID for access point. This must be same on all remote devices.
const char* apPassword = "";       // Password for Access point if required otherwise leave blank.
const int apChannel = 7;           // WiFi Channel number for access point. This must be same on all remote devices.
const int hidden = 0;              // If hidden is 1 probe request event handling does not work ?
int wsport = 8084;                 // Websocket server port

#if PROBEREQUESTS
// Channge following according to your remote sensor types for each device.
int Livingroom[4] = {16,26,36,46}; // temperature = 16, humidity= 26, pressure= 36, light= 46, OpenClose = 56, level = 66, presence = 76, motion = 86, rain = 96 etc.
int Kitchen[4] =    {46,36,26,16};
int Bedroom1[4] =   {46,36,26,16};
int Bedroom2[4] =   {16,26,36,36};
int Bedroom3[4] =   {16,26,36,36};
int Bedroom4[4] =   {16,26,36,36};
int Bathroom1[4] =  {16,26,36,36};
int Bathroom2[4] =  {16,26,36,36};
int Bathroom3[4] =  {16,26,36,36};
int Bathroom4[4] =  {16,26,36,36};
int Laundry[4] =    {16,26,36,36};
int Boiler[4] =     {16,26,36,36};
int Workshop[4] =   {16,26,36,36};
int Garage[4] =     {16,26,36,36};
int Office[4] =     {16,26,36,36};
int Tank[4] =       {16,26,36,36};
int Solar[4] =      {16,26,36,36};

//================= No user confiuration required below this line =================================================


#include <esp_wifi.h>
char str [256];
char s [70];
String deviceData;
String sensorData;
String graphData;
int device;
int voltage;
int rssi;
uint8_t mac[6];
int sensorValues[4];
int sensorTypes[4];
int deviceStatus[4];
#endif

#if MQTT
#include <TinyMqtt.h>   // Thanks to https://github.com/hsaturn/TinyMqtt
#endif

#if WEBSOCKETS
#include <ArduinoWebsockets.h>  // Thanks to https://github.com/gilmaimon/ArduinoWebsockets
using namespace websockets;
WebsocketsServer WSserver;
std::vector<WebsocketsClient> allClients;  // a collection of all connected clients
#endif

#if ASYNCWEBSERVER
#include <ESPAsyncWebServer.h>  // Install manually to arduino folder
int index_html_gz_len = 18830;
const uint8_t index_html_gz[] = {
0x1f,0x8b,0x08,0x08,0x0c,0x9e,0xbe,0x60,0x00,0xff,0x69,0x6e,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0x00
};
AsyncWebServer webserver(80);
#endif


#if WEBSOCKETS
void onMessage(WebsocketsClient& client, WebsocketsMessage message) {
  Serial.print("Message Received from javascript websocket client: ");
  Serial.println(message.data()); 

  }

void pollAllClients() {    // This method goes thrugh every client and polls for new messages and events

  for(auto& client : allClients) {
    client.poll();
  }
}
#endif

#if MQTT
std::string sentTopic = "data";
std::string receivedTopic = "command";
MqttBroker broker(1883);
MqttClient myClient(&broker);

void receivedMessage(const MqttClient* source, const Topic& topic, const char* payload, size_t length)
{
  Serial.print("Received message on topic '"); 
  Serial.print(receivedTopic.c_str());
  Serial.print("' with payload = ");
  Serial.println(payload);
    if (receivedTopic == "command")
  {
    mac[0] = atoi(&payload[0]);
    mac[1] = atoi(&payload[3]);
    mac[2] = atoi(&payload[6]);
    mac[3] = atoi(&payload[9]);
    mac[4] = atoi(&payload[12]);
    mac[5] = atoi(&payload[15]);
   }
 }
#endif

const char* ntpServer = "pool.ntp.org";
unsigned long epoch; 

unsigned long getTime() {
  time_t now;
  struct tm timeinfo;
  if (!getLocalTime(&timeinfo)) {
    //Serial.println("Failed to obtain time");
    return(0);
  }
  time(&now);
  return now;
}



void setup() {

  Serial.begin(115200);
  
  delay(500);
  Serial.println("Starting WiFi client and AP.......");

  WiFi.mode(WIFI_STA);
  WiFi.begin(ssid, password);
  while (WiFi.status() != WL_CONNECTED) {   Serial.print("-"); delay(500); }
  WiFi.softAP(apSSID, apPassword, apChannel, hidden);
  esp_wifi_set_event_mask(WIFI_EVENT_MASK_NONE); // This line is must to activate probe request received event handler.
  Serial.print("The AP mac address is: ");
  Serial.println(WiFi.softAPmacAddress().c_str());
  Serial.print("Access point started with SSID '");
  Serial.print(apSSID);
  Serial.print("' and webserver started at IP address: ");
  Serial.println(WiFi.localIP());
  Serial.print("Websocket Server at Port: ");
  Serial.println(wsport);
  
  configTime(0, 0, ntpServer);
  epoch = getTime();
  Serial.print("Epoch Time: ");
  Serial.println(epoch);
  
  delay(1000);

  LITTLEFS.begin(true);
  
#if FIRSTTIME
  File f = LITTLEFS.open("/sensors.csv", "w");
  f.println("epoch,loc,v,s,t,h,p,l");
  f.close();
  Serial.println("Wrote first line to file : epoch,loc,v,s,t,h,p,l");
  Serial.println();
#endif
    
#if ASYNCWEBSERVER
    webserver.on("/", HTTP_GET, [](AsyncWebServerRequest * request) 
    {
    AsyncWebServerResponse *response = request->beginResponse_P(200, "text/html", index_html_gz, sizeof(index_html_gz));
    response->addHeader("Content-Encoding", "gzip");
    request->send(response);
    });
    
    webserver.begin();
#endif
    
#if WEBSOCKETS
    WSserver.listen(wsport);
#endif

#if MQTT
    broker.begin();

  // ============= Client Subscribe ================
    myClient.setCallback(receivedMessage);
    myClient.subscribe(receivedTopic);
    myClient.subscribe(sentTopic);
#endif

#if PROBEREQUESTS
    WiFi.onEvent(probeRequest, SYSTEM_EVENT_AP_PROBEREQRECVED);
    Serial.print("Waiting for probe requests ... ");
#endif   
} // end of setup

void loop() {

#if WEBSOCKETS
 while (WSserver.available()) {
    
    if(WSserver.poll()) {  // if there is a client that wants to connect
      
      Serial.println("Accepting a new client!");
      WebsocketsClient client = WSserver.accept(); // Accept the connection
      client.onMessage(onMessage);                 // Register callback
      //String graphData = "[1623287518,56,-28,289,58,72,256,77],1623287668,26,-36,302,52,78,266,66],1623287788,16,-32,256,45,84,286,72],1623287899,6,-24,288,42,86,254,66]";
      //client.send(graphData);
      allClients.push_back(client); // Store it for later use
     }
      
      pollAllClients();      // Check for updates in all clients
      
      #if MQTT
       broker.loop();  // Don't forget to add loop for every broker and clients
       myClient.loop();
      #endif
   }  
#endif  
} // End of loop


#if PROBEREQUESTS

void probeRequest(WiFiEvent_t event, WiFiEventInfo_t info) 
{
    Serial.print("Probe Received :  ");
    for (int i = 0; i < 6; i++) {
    Serial.printf("%02X", info.ap_probereqrecved.mac[i]);
    if (i < 5)Serial.print(":");
    }
    Serial.println();

      if (info.ap_probereqrecved.mac[0] == 6 || info.ap_probereqrecved.mac[0] == 16 || info.ap_probereqrecved.mac[0] == 26 || info.ap_probereqrecved.mac[0] == 36 || info.ap_probereqrecved.mac[0] == 46 || info.ap_probereqrecved.mac[0] == 56 || info.ap_probereqrecved.mac[0] == 66 || info.ap_probereqrecved.mac[0] == 76 || info.ap_probereqrecved.mac[0] == 86 || info.ap_probereqrecved.mac[0] == 96 || info.ap_probereqrecved.mac[0] == 106 || info.ap_probereqrecved.mac[0] == 116 || info.ap_probereqrecved.mac[0] == 126 || info.ap_probereqrecved.mac[0] == 136 || info.ap_probereqrecved.mac[0] == 146 || info.ap_probereqrecved.mac[0] == 156 || info.ap_probereqrecved.mac[0] == 166 || info.ap_probereqrecved.mac[0] == 176 || info.ap_probereqrecved.mac[0] == 186 || info.ap_probereqrecved.mac[0] == 196 || info.ap_probereqrecved.mac[0] == 206 || info.ap_probereqrecved.mac[0] == 216 || info.ap_probereqrecved.mac[0] == 226 || info.ap_probereqrecved.mac[0] == 236 || info.ap_probereqrecved.mac[0] == 246) // only accept data from certain devices.
       {
       
      //sendCommand();

      if (info.ap_probereqrecved.mac[1] == 06) 
      { // only accept data from device with voltage as a sensor type at byte 1.
               if (device == 06) { for (int i = 0; i < 4; i++) sensorTypes[i] = Livingroom[i];} 
               if (device == 16) { for (int i = 0; i < 4; i++) sensorTypes[i] = Kitchen[i];}
               if (device == 26) { for (int i = 0; i < 4; i++) sensorTypes[i] = Bedroom1[i];} 
               if (device == 36) { for (int i = 0; i < 4; i++) sensorTypes[i] = Bedroom2[i];}
               if (device == 46) { for (int i = 0; i < 4; i++) sensorTypes[i] = Bedroom3[i];} 
               if (device == 56) { for (int i = 0; i < 4; i++) sensorTypes[i] = Bedroom4[i];}
               if (device == 66) { for (int i = 0; i < 4; i++) sensorTypes[i] = Bathroom1[i];} 
               if (device == 76) { for (int i = 0; i < 4; i++) sensorTypes[i] = Bathroom2[i];}
               if (device == 86) { for (int i = 0; i < 4; i++) sensorTypes[i] = Bathroom3[i];} 
               if (device == 96) { for (int i = 0; i < 4; i++) sensorTypes[i] = Bathroom4[i];}
               if (device == 106) { for (int i = 0; i < 4; i++) sensorTypes[i] = Laundry[i];} 
               if (device == 116) { for (int i = 0; i < 4; i++) sensorTypes[i] = Boiler[i];}
               if (device == 126) { for (int i = 0; i < 4; i++) sensorTypes[i] = Workshop[i];} 
               if (device == 136) { for (int i = 0; i < 4; i++) sensorTypes[i] = Garage[i];}
               if (device == 146) { for (int i = 0; i < 4; i++) sensorTypes[i] = Office[i];}
               if (device == 156) { for (int i = 0; i < 4; i++) sensorTypes[i] = Tank[i];} 
               if (device == 166) { for (int i = 0; i < 4; i++) sensorTypes[i] = Solar[i];}
               deviceStatus[0] = info.ap_probereqrecved.mac[2];
               deviceStatus[1] = info.ap_probereqrecved.mac[3];
               deviceStatus[2] = info.ap_probereqrecved.mac[4];
               deviceStatus[3] = info.ap_probereqrecved.mac[5];
      } else {

      device = info.ap_probereqrecved.mac[0];
      rssi = info.ap_probereqrecved.rssi;         
      voltage = info.ap_probereqrecved.mac[1];
      voltage = voltage * 2;
                  
      sensorValues[0] = info.ap_probereqrecved.mac[2];
      sensorValues[1] = info.ap_probereqrecved.mac[3];
      sensorValues[2] = info.ap_probereqrecved.mac[4];
      sensorValues[3] = info.ap_probereqrecved.mac[5];
              
      }

      if (voltage > 250 && voltage < 360) 
      {
      
      sprintf (str, "{");
      sprintf (s, "\"%s\":\"%i\"", "Location", device); strcat (str, s);
      sprintf (s, ",\"%s\":\"%i\"", "Voltage", voltage); strcat (str, s);
      sprintf (s, ",\"%i\":\"%i\"", sensorTypes[0], sensorValues[0]); strcat (str, s);
      sprintf (s, ",\"%i\":\"%i\"", sensorTypes[1], sensorValues[1]); strcat (str, s);
      sprintf (s, ",\"%i\":\"%i\"", sensorTypes[2], sensorValues[2]); strcat (str, s);
      sprintf (s, ",\"%i\":\"%i\"", sensorTypes[3], sensorValues[3]); strcat (str, s);
      sprintf (s, "}"); strcat (str, s);
              
      Serial.println();
      Serial.println("Following ## Sensor Values ## receiced from remote device  & published via MQTT: ");
      Serial.println(str);
      Serial.println();
      #if MQTT
      myClient.publish("sensor", str);
      #endif
      if (voltage < 2.50) {      // if voltage of battery gets to low, print the warning below.
         //myClient.publish("Warning/Battery Low", location);
       }
     }

   if (info.ap_probereqrecved.mac[3] == apChannel) {
     
     sprintf (str, "{");
     sprintf (s, "\"%s\":\"%i\"", "Location", device);    strcat (str, s);
     sprintf (s, ",\"%s\":\"%i\"", "RSSI", info.ap_probereqrecved.rssi); strcat (str, s);
     sprintf (s, ",\"%s\":\"%i\"", "MODE", deviceStatus[0]); strcat (str, s);
     sprintf (s, ",\"%s\":\"%i\"", "CHANNEL", deviceStatus[1]); strcat (str, s);
     sprintf (s, ",\"%s\":\"%i\"", "IP", deviceStatus[2]); strcat (str, s);
     sprintf (s, ",\"%s\":\"%i\"", "Sleeptime", deviceStatus[3]); strcat (str, s);
     sprintf (s, "}"); strcat (str, s);
                           
     Serial.println();
     Serial.println("Following ## Device Status ## receiced from remote device & published via MQTT: ");
     Serial.println(str);
     Serial.println();
     #if MQTT
     myClient.publish("device", str);
     #endif
     epoch = getTime();
     graphData = epoch;
     graphData += ",";
     graphData = device;
     graphData += ",";
     graphData += voltage;
     graphData += ",";
     graphData += rssi;
     graphData += ",";
     graphData += sensorValues[0];
     graphData += ",";
     graphData += sensorValues[1];
     graphData += ",";
     graphData += sensorValues[2];
     graphData += ",";
     graphData += sensorValues[3];
     
     File f = LITTLEFS.open("/sensors.csv", "a");
     f.println(graphData);
     Serial.println();
     Serial.print("Appended to file: "); Serial.println(graphData);
     Serial.print("File size: "); Serial.println(f.size());
     f.close(); 

     f = LITTLEFS.open("/sensors.csv", "r");
     Serial.println("Reading from sensors.csv file...");
     while(f.available()){
     Serial.write(f.read());
     }
     f.close();
   }
  }
 }
#endif 
